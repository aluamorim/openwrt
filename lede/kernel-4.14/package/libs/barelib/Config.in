## lede/kernel-4.14/package/libs/barelib/Config.in
```kconfig
menu "Barelib"
	tristate "Baresip userspace lib"
	default y

config BARELIB
	tristate "Baresip userspace lib"
	default y
	help
		The barelib package installs the necessary
        .so libraries to run baresip-based applications
        on /usr/lib directory of the image. (ALU)
endmenu


         
```

## porting/kernel-4.14.37/package/libs/zzzbarelib/Config.in
```kconfig
menu "zzzBarelib"
	tristate "Baresip userspace lib"
	default y

config ZZZBARELIB
	tristate "Baresip userspace lib"
	default y
	help
		The barelib package installs the necessary
        .so libraries to run baresip-based applications
        on /usr/lib directory of the image. (ALU)
endmenu


         
```

## porting/libs/zzzbarelib/Config.in
```kconfig
menu "zzzbarelib"
	tristate "Baresip userspace lib"
	default y

config ZZZBARELIB
	tristate "Baresip userspace lib"
	default y
	help
		The barelib package installs the necessary
        .so libraries to run baresip-based applications
        on /root directory of the image. (ALU)
endmenu


         
```
